## riotgen/templates/board/Kconfig.j2
```kconfig
# SPDX-FileCopyrightText: {{ global.year }} {{ global.organization }}
# SPDX-License-Identifier: {{ global.license_header }}

config BOARD
    default "{{ board.name }}" if BOARD_{{ board.name | upper | replace("-", "_") }}

config BOARD_{{ board.name | upper | replace("-", "_") }}
    bool
    default y
    select CPU_MODEL_{{ board.cpu_model | upper }}

    # Put defined MCU peripherals here (in alphabetical order)
{% for feature in board.features_provided %}
    select HAS_{{ feature | upper }}
{% endfor %}

    # Put other features for this board (in alphabetical order)
```

## riotgen/templates/driver/Kconfig.j2
```kconfig
# SPDX-FileCopyrightText: {{ global.year }} {{ global.organization }}
# SPDX-License-Identifier: {{ global.license_header }}

config MODULE_{{ driver.name | upper | replace("-", "_") }}
    bool "{{ driver.displayed_name }}"
    depends on TEST_KCONFIG
{% for feature in driver.features_required %}
    depends on HAS_{{ feature | upper }}
{% endfor %}
{% for package in driver.packages %}
    select PACKAGE_{{ package | upper }}
{% endfor %}
{% for feature in driver.features_required %}
    select MODULE_{{ feature | upper }}
{% endfor %}
{% for module in driver.modules %}
    select MODULE_{{ module | upper }}
{% endfor %}
```

## riotgen/templates/pkg/Kconfig.j2
```kconfig
# SPDX-FileCopyrightText: {{ global.year }} {{ global.organization }}
# SPDX-License-Identifier: {{ global.license_header }}

config PACKAGE_{{ pkg.name | upper | replace("-", "_") }}
    bool "{{ pkg.displayed_name }}"
    depends on TEST_KCONFIG
{% for feature in pkg.features_required %}
    depends on HAS_{{ feature | upper }}
{% endfor %}
{% for package in pkg.packages %}
    select PACKAGE_{{ package | upper }}
{% endfor %}
{% for feature in pkg.features_required %}
    select MODULE_{{ feature | upper }}
{% endfor %}
{% for module in pkg.modules %}
    select MODULE_{{ module | upper }}
{% endfor %}
```

## riotgen/tests/test_data/board/Kconfig
```kconfig
# SPDX-FileCopyrightText: 2026 test_orga
# SPDX-License-Identifier: LGPL-2.1-only

config BOARD
    default "test" if BOARD_TEST

config BOARD_TEST
    bool
    default y
    select CPU_MODEL_CPU_MODEL_TEST

    # Put defined MCU peripherals here (in alphabetical order)
    select HAS_PERIPH_GPIO

    # Put other features for this board (in alphabetical order)
```

## riotgen/tests/test_data/driver/Kconfig
```kconfig
# SPDX-FileCopyrightText: 2026 test_orga
# SPDX-License-Identifier: LGPL-2.1-only

config MODULE_TEST
    bool "Test"
    depends on TEST_KCONFIG
    depends on HAS_PERIPH_I2C
    select MODULE_PERIPH_I2C
    select MODULE_XTIMER
```

## riotgen/tests/test_data/pkg/Kconfig
```kconfig
# SPDX-FileCopyrightText: 2026 test_orga
# SPDX-License-Identifier: LGPL-2.1-only

config PACKAGE_TEST
    bool "Test"
    depends on TEST_KCONFIG
    select MODULE_FMT
    select MODULE_XTIMER
```
